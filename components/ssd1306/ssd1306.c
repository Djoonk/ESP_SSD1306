#include <string.h>
#include "ssd1306.h"
#include "esp_log.h"
#include "esp_check.h"

static const char *TAG = "ssd1306";

/* Device handle stored internally after ssd1306_init() */
static i2c_master_dev_handle_t s_dev = NULL;

/* ------------------------------------------------------------------ */
/*  Frame buffer                                                        */
/* ------------------------------------------------------------------ */

static uint8_t buffer[SSD1306_WIDTH * SSD1306_HEIGHT / 8];

/* ------------------------------------------------------------------ */
/*  Built-in 5x7 ASCII font  (0x20..0x7E)                              */
/*  Each glyph = 5 bytes; each byte = one column; bit 0 = top row.    */
/* ------------------------------------------------------------------ */

static const uint8_t font5x7[][5] = {
    /* 0x20  ' ' */ {0x00,0x00,0x00,0x00,0x00},
    /* 0x21  '!' */ {0x00,0x00,0x5F,0x00,0x00},
    /* 0x22  '"' */ {0x00,0x07,0x00,0x07,0x00},
    /* 0x23  '#' */ {0x14,0x7F,0x14,0x7F,0x14},
    /* 0x24  '$' */ {0x24,0x2A,0x7F,0x2A,0x12},
    /* 0x25  '%' */ {0x23,0x13,0x08,0x64,0x62},
    /* 0x26  '&' */ {0x36,0x49,0x55,0x22,0x50},
    /* 0x27  ''' */ {0x00,0x05,0x03,0x00,0x00},
    /* 0x28  '(' */ {0x00,0x1C,0x22,0x41,0x00},
    /* 0x29  ')' */ {0x00,0x41,0x22,0x1C,0x00},
    /* 0x2A  '*' */ {0x14,0x08,0x3E,0x08,0x14},
    /* 0x2B  '+' */ {0x08,0x08,0x3E,0x08,0x08},
    /* 0x2C  ',' */ {0x00,0x50,0x30,0x00,0x00},
    /* 0x2D  '-' */ {0x08,0x08,0x08,0x08,0x08},
    /* 0x2E  '.' */ {0x00,0x60,0x60,0x00,0x00},
    /* 0x2F  '/' */ {0x20,0x10,0x08,0x04,0x02},
    /* 0x30  '0' */ {0x3E,0x51,0x49,0x45,0x3E},
    /* 0x31  '1' */ {0x00,0x42,0x7F,0x40,0x00},
    /* 0x32  '2' */ {0x42,0x61,0x51,0x49,0x46},
    /* 0x33  '3' */ {0x21,0x41,0x45,0x4B,0x31},
    /* 0x34  '4' */ {0x18,0x14,0x12,0x7F,0x10},
    /* 0x35  '5' */ {0x27,0x45,0x45,0x45,0x39},
    /* 0x36  '6' */ {0x3C,0x4A,0x49,0x49,0x30},
    /* 0x37  '7' */ {0x01,0x71,0x09,0x05,0x03},
    /* 0x38  '8' */ {0x36,0x49,0x49,0x49,0x36},
    /* 0x39  '9' */ {0x06,0x49,0x49,0x29,0x1E},
    /* 0x3A  ':' */ {0x00,0x36,0x36,0x00,0x00},
    /* 0x3B  ';' */ {0x00,0x56,0x36,0x00,0x00},
    /* 0x3C  '<' */ {0x08,0x14,0x22,0x41,0x00},
    /* 0x3D  '=' */ {0x14,0x14,0x14,0x14,0x14},
    /* 0x3E  '>' */ {0x00,0x41,0x22,0x14,0x08},
    /* 0x3F  '?' */ {0x02,0x01,0x51,0x09,0x06},
    /* 0x40  '@' */ {0x32,0x49,0x79,0x41,0x3E},
    /* 0x41  'A' */ {0x7E,0x11,0x11,0x11,0x7E},
    /* 0x42  'B' */ {0x7F,0x49,0x49,0x49,0x36},
    /* 0x43  'C' */ {0x3E,0x41,0x41,0x41,0x22},
    /* 0x44  'D' */ {0x7F,0x41,0x41,0x22,0x1C},
    /* 0x45  'E' */ {0x7F,0x49,0x49,0x49,0x41},
    /* 0x46  'F' */ {0x7F,0x09,0x09,0x09,0x01},
    /* 0x47  'G' */ {0x3E,0x41,0x49,0x49,0x7A},
    /* 0x48  'H' */ {0x7F,0x08,0x08,0x08,0x7F},
    /* 0x49  'I' */ {0x00,0x41,0x7F,0x41,0x00},
    /* 0x4A  'J' */ {0x20,0x40,0x41,0x3F,0x01},
    /* 0x4B  'K' */ {0x7F,0x08,0x14,0x22,0x41},
    /* 0x4C  'L' */ {0x7F,0x40,0x40,0x40,0x40},
    /* 0x4D  'M' */ {0x7F,0x02,0x0C,0x02,0x7F},
    /* 0x4E  'N' */ {0x7F,0x04,0x08,0x10,0x7F},
    /* 0x4F  'O' */ {0x3E,0x41,0x41,0x41,0x3E},
    /* 0x50  'P' */ {0x7F,0x09,0x09,0x09,0x06},
    /* 0x51  'Q' */ {0x3E,0x41,0x51,0x21,0x5E},
    /* 0x52  'R' */ {0x7F,0x09,0x19,0x29,0x46},
    /* 0x53  'S' */ {0x46,0x49,0x49,0x49,0x31},
    /* 0x54  'T' */ {0x01,0x01,0x7F,0x01,0x01},
    /* 0x55  'U' */ {0x3F,0x40,0x40,0x40,0x3F},
    /* 0x56  'V' */ {0x1F,0x20,0x40,0x20,0x1F},
    /* 0x57  'W' */ {0x3F,0x40,0x38,0x40,0x3F},
    /* 0x58  'X' */ {0x63,0x14,0x08,0x14,0x63},
    /* 0x59  'Y' */ {0x07,0x08,0x70,0x08,0x07},
    /* 0x5A  'Z' */ {0x61,0x51,0x49,0x45,0x43},
    /* 0x5B  '[' */ {0x00,0x7F,0x41,0x41,0x00},
    /* 0x5C  '\' */ {0x02,0x04,0x08,0x10,0x20},
    /* 0x5D  ']' */ {0x00,0x41,0x41,0x7F,0x00},
    /* 0x5E  '^' */ {0x04,0x02,0x01,0x02,0x04},
    /* 0x5F  '_' */ {0x40,0x40,0x40,0x40,0x40},
    /* 0x60  '`' */ {0x00,0x01,0x02,0x04,0x00},
    /* 0x61  'a' */ {0x20,0x54,0x54,0x54,0x78},
    /* 0x62  'b' */ {0x7F,0x48,0x44,0x44,0x38},
    /* 0x63  'c' */ {0x38,0x44,0x44,0x44,0x20},
    /* 0x64  'd' */ {0x38,0x44,0x44,0x48,0x7F},
    /* 0x65  'e' */ {0x38,0x54,0x54,0x54,0x18},
    /* 0x66  'f' */ {0x08,0x7E,0x09,0x01,0x02},
    /* 0x67  'g' */ {0x0C,0x52,0x52,0x52,0x3E},
    /* 0x68  'h' */ {0x7F,0x08,0x04,0x04,0x78},
    /* 0x69  'i' */ {0x00,0x44,0x7D,0x40,0x00},
    /* 0x6A  'j' */ {0x20,0x40,0x44,0x3D,0x00},
    /* 0x6B  'k' */ {0x7F,0x10,0x28,0x44,0x00},
    /* 0x6C  'l' */ {0x00,0x41,0x7F,0x40,0x00},
    /* 0x6D  'm' */ {0x7C,0x04,0x18,0x04,0x78},
    /* 0x6E  'n' */ {0x7C,0x08,0x04,0x04,0x78},
    /* 0x6F  'o' */ {0x38,0x44,0x44,0x44,0x38},
    /* 0x70  'p' */ {0x7C,0x14,0x14,0x14,0x08},
    /* 0x71  'q' */ {0x08,0x14,0x14,0x18,0x7C},
    /* 0x72  'r' */ {0x7C,0x08,0x04,0x04,0x08},
    /* 0x73  's' */ {0x48,0x54,0x54,0x54,0x20},
    /* 0x74  't' */ {0x04,0x3F,0x44,0x40,0x20},
    /* 0x75  'u' */ {0x3C,0x40,0x40,0x20,0x7C},
    /* 0x76  'v' */ {0x1C,0x20,0x40,0x20,0x1C},
    /* 0x77  'w' */ {0x3C,0x40,0x30,0x40,0x3C},
    /* 0x78  'x' */ {0x44,0x28,0x10,0x28,0x44},
    /* 0x79  'y' */ {0x0C,0x50,0x50,0x50,0x3C},
    /* 0x7A  'z' */ {0x44,0x64,0x54,0x4C,0x44},
    /* 0x7B  '{' */ {0x00,0x08,0x36,0x41,0x00},
    /* 0x7C  '|' */ {0x00,0x00,0x7F,0x00,0x00},
    /* 0x7D  '}' */ {0x00,0x41,0x36,0x08,0x00},
    /* 0x7E  '~' */ {0x10,0x08,0x08,0x10,0x08},
};

#define FONT_FIRST  0x20
#define FONT_LAST   0x7E
#define GLYPH_W     5    /* columns per glyph  */
#define CHAR_W      6    /* glyph + 1 px gap   */

/* ------------------------------------------------------------------ */
/*  Low-level helpers — ESP-IDF v5.x new I2C master API               */
/* ------------------------------------------------------------------ */

/*
 * Send one or more command bytes to the SSD1306.
 *
 * Wire format:  START | ADDR+W | 0x00 (Co=0, D/C#=0) | cmd... | STOP
 *
 * The new API does not use cmd-link objects. Instead we build a small
 * tx buffer:  [ control_byte | payload... ]  and call transmit once.
 */
static esp_err_t send_cmd_buf(const uint8_t *cmds, size_t len)
{
    /* 1 control byte + up to len command bytes — keep it on the stack */
    uint8_t tx[1 + 32];   /* 32 cmd bytes is more than enough for init */
    if (len > sizeof(tx) - 1) return ESP_ERR_INVALID_SIZE;

    tx[0] = SSD1306_CTRL_CMD;
    memcpy(tx + 1, cmds, len);

    esp_err_t ret = i2c_master_transmit(s_dev, tx, 1 + len,
                                        SSD1306_I2C_TIMEOUT_MS);
    if (ret != ESP_OK)
        ESP_LOGE(TAG, "send_cmd_buf failed: %s", esp_err_to_name(ret));

    return ret;
}

static inline esp_err_t send_cmd(uint8_t cmd)
{
    return send_cmd_buf(&cmd, 1);
}

static esp_err_t send_cmd2(uint8_t cmd, uint8_t arg)
{
    uint8_t buf[2] = { cmd, arg };
    return send_cmd_buf(buf, sizeof(buf));
}

/* ------------------------------------------------------------------ */
/*  Initialisation sequence for 128x32                                 */
/* ------------------------------------------------------------------ */

void ssd1306_init(i2c_master_dev_handle_t dev_handle)
{
    s_dev = dev_handle;
    send_cmd (SSD1306_DISPLAY_OFF);

    send_cmd2(SSD1306_SET_DISPLAY_CLOCK_DIV, 0x80);  /* recommended ratio */
    send_cmd2(SSD1306_SET_MULTIPLEX,         0x1F);  /* 32 lines          */
    send_cmd2(SSD1306_SET_DISPLAY_OFFSET,    0x00);
    send_cmd (SSD1306_SET_START_LINE | 0x00);
    send_cmd2(SSD1306_CHARGE_PUMP,           0x14);  /* internal VCC      */
    send_cmd2(SSD1306_MEMORY_MODE,           0x00);  /* horizontal addr   */
    send_cmd (SSD1306_SEG_REMAP_FLIP);               /* col 127 → SEG0   */
    send_cmd (SSD1306_COM_SCAN_DEC);
    send_cmd2(SSD1306_SET_COM_PINS,          0x02);  /* 32-line config    */
    send_cmd2(SSD1306_SET_CONTRAST,          0xCF);
    send_cmd2(SSD1306_SET_PRECHARGE,         0xF1);
    send_cmd2(SSD1306_SET_VCOM_DETECT,       0x40);
    send_cmd (SSD1306_DISPLAY_ALL_ON_RESUME);
    send_cmd (SSD1306_NORMAL_DISPLAY);
    send_cmd (SSD1306_DISPLAY_ON);

    ssd1306_fill(SSD1306_BLACK);
    ssd1306_update();
}

/* ------------------------------------------------------------------ */
/*  Frame-buffer → display                                             */
/* ------------------------------------------------------------------ */

void ssd1306_update(void)
{
    /* Set column and page window to cover the full display */
    uint8_t addr_cmds[] = {
        SSD1306_COLUMN_ADDR, 0, SSD1306_WIDTH - 1,
        SSD1306_PAGE_ADDR,   0, (SSD1306_HEIGHT / 8) - 1,
    };
    send_cmd_buf(addr_cmds, sizeof(addr_cmds));

    /*
     * Send the frame buffer in one I2C transaction:
     *   [ 0x40 | 512 bytes of framebuffer ]
     *
     * We need a contiguous tx buffer: 1 control byte + 512 data bytes.
     * Declared static to avoid a 513-byte stack allocation.
     */
    static uint8_t tx[1 + SSD1306_WIDTH * SSD1306_HEIGHT / 8];
    tx[0] = SSD1306_CTRL_DATA;
    memcpy(tx + 1, buffer, sizeof(buffer));

    esp_err_t ret = i2c_master_transmit(s_dev, tx, sizeof(tx),
                                        SSD1306_I2C_TIMEOUT_MS);
    if (ret != ESP_OK)
        ESP_LOGE(TAG, "ssd1306_update failed: %s", esp_err_to_name(ret));
}

/* ------------------------------------------------------------------ */
/*  Drawing primitives                                                  */
/* ------------------------------------------------------------------ */

void ssd1306_fill(uint8_t color)
{
    memset(buffer, color ? 0xFF : 0x00, sizeof(buffer));
}

void ssd1306_draw_pixel(uint8_t x, uint8_t y, uint8_t color)
{
    if (x >= SSD1306_WIDTH || y >= SSD1306_HEIGHT) return;

    uint16_t byte_idx = x + (y / 8) * SSD1306_WIDTH;
    uint8_t  bit_mask = 1u << (y % 8);

    if (color)
        buffer[byte_idx] |=  bit_mask;
    else
        buffer[byte_idx] &= ~bit_mask;
}

void ssd1306_draw_char(uint8_t x, uint8_t y, const uint8_t *glyph)
{
    for (uint8_t col = 0; col < GLYPH_W; col++) {
        uint8_t column_data = glyph[col];
        for (uint8_t row = 0; row < 8; row++) {
            if (column_data & (1u << row))
                ssd1306_draw_pixel(x + col, y + row, SSD1306_WHITE);
        }
    }
}

void ssd1306_draw_string(uint8_t x, uint8_t y, const char *str)
{
    while (*str) {
        uint8_t c = (uint8_t)*str;

        if (c >= FONT_FIRST && c <= FONT_LAST)
            ssd1306_draw_char(x, y, font5x7[c - FONT_FIRST]);

        x += CHAR_W;
        str++;
    }
}