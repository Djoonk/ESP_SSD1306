#include "ssd1306.h"
#include "i2c_bus.h"
#include "freertos/FreeRTOS.h"
#include "freertos/task.h"
#include <string.h>

i2c_master_dev_handle_t ssd1306_dev = NULL;

static uint8_t fb[SSD1306_WIDTH * (SSD1306_HEIGHT / 8)];

static const uint8_t font6x8[][6] = {
    {0x00,0x00,0x00,0x00,0x00,0x00}, // ' '
    {0x00,0x00,0x5F,0x00,0x00,0x00}, // '!'
    {0x00,0x07,0x00,0x07,0x00,0x00}, // '"'
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    {0x44,0x64,0x54,0x4C,0x44,0x00}, // 'z'
};

static void ssd1306_cmd(uint8_t cmd)
{
    uint8_t buf[2] = {0x00, cmd};
    i2c_master_transmit(ssd1306_dev, buf, 2, 10);
}

void ssd1306_init(void)
{
    i2c_device_config_t cfg = {
        .dev_addr_length = I2C_ADDR_BIT_LEN_7,
        .device_address  = SSD1306_ADDR,
        .scl_speed_hz    = 400000,
    };
    i2c_master_bus_add_device(g_i2c_bus, &cfg, &ssd1306_dev);

    vTaskDelay(pdMS_TO_TICKS(100));

    uint8_t init_seq[] = {
        0xAE, 0xD5, 0x80, 0xA8, 0x1F,
        0xD3, 0x00, 0x40, 0x8D, 0x14,
        0x20, 0x00, 0xA1, 0xC8, 0xDA,
        0x02, 0x81, 0xCF, 0xD9, 0xF1,
        0xDB, 0x40, 0xA4, 0xA6, 0xAF,
    };
    for (int i = 0; i < (int)sizeof(init_seq); i++)
        ssd1306_cmd(init_seq[i]);

    ssd1306_clear();
    ssd1306_flush();
}

void ssd1306_clear(void)
{
    memset(fb, 0, sizeof(fb));
}

void ssd1306_draw_text(uint8_t col, uint8_t row, const char *text)
{
    uint8_t x = col * 6;
    while (*text && x < SSD1306_WIDTH) {
        char c = *text++;
        if (c < ' ' || c > 'z') c = ' ';
        const uint8_t *g = font6x8[c - ' '];
        for (int i = 0; i < 6; i++)
            if (x + i < SSD1306_WIDTH)
                fb[row * SSD1306_WIDTH + x + i] = g[i];
        x += 6;
    }
}

void ssd1306_flush(void)
{
    ssd1306_cmd(0x21); ssd1306_cmd(0); ssd1306_cmd(127);
    ssd1306_cmd(0x22); ssd1306_cmd(0); ssd1306_cmd(3);

    static uint8_t buf[SSD1306_WIDTH * (SSD1306_HEIGHT / 8) + 1];
    buf[0] = 0x40;
    memcpy(&buf[1], fb, sizeof(fb));
    i2c_master_transmit(ssd1306_dev, buf, sizeof(buf), 50);
}